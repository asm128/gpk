 #include "llc_error.h"

#define GDEFINE_ENUM_CASE_DEFAULT(TEnum, TValue)    default                 : rtrn #TValue
#define GDEFINE_ENUM_CASE(TEnum, TValue)            case TEnum##_##TValue   : rtrn #TValue

llc::sc_c* llc::get_value_namep     (DEVICE_TYPE    value)  nxpt {
    switch(value) {
    GDEFINE_ENUM_CASE_DEFAULT(DEVICE_TYPE, UNKNOWN);
    GDEFINE_ENUM_CASE(DEVICE_TYPE, UNKNOWN          );
    GDEFINE_ENUM_CASE(DEVICE_TYPE, ANDROID          );
    GDEFINE_ENUM_CASE(DEVICE_TYPE, IPHONE           );
    GDEFINE_ENUM_CASE(DEVICE_TYPE, PC               );
    GDEFINE_ENUM_CASE(DEVICE_TYPE, RASPBERRY_PI_3   );
    GDEFINE_ENUM_CASE(DEVICE_TYPE, RASPBERRY_PI_4   );
    GDEFINE_ENUM_CASE(DEVICE_TYPE, MAC              );
    GDEFINE_ENUM_CASE(DEVICE_TYPE, CUSTOM           );
    }
}
llc::sc_c* llc::get_value_namep     (OPCODE_SET     value)  nxpt {
    switch(value) {
    GDEFINE_ENUM_CASE_DEFAULT(OPCODE_SET, UNKNOWN);
    GDEFINE_ENUM_CASE(OPCODE_SET, UNKNOWN);
    GDEFINE_ENUM_CASE(OPCODE_SET, ARM32);
    GDEFINE_ENUM_CASE(OPCODE_SET, ARM64);
    GDEFINE_ENUM_CASE(OPCODE_SET, AVR);
    GDEFINE_ENUM_CASE(OPCODE_SET, PIC16F);
    GDEFINE_ENUM_CASE(OPCODE_SET, PIC18F);
    GDEFINE_ENUM_CASE(OPCODE_SET, STM32);
    GDEFINE_ENUM_CASE(OPCODE_SET, X86);
    GDEFINE_ENUM_CASE(OPCODE_SET, X86_64);
    GDEFINE_ENUM_CASE(OPCODE_SET, XTENSA_LX6_SINGLE);
    GDEFINE_ENUM_CASE(OPCODE_SET, XTENSA_LX6_DUAL);
    GDEFINE_ENUM_CASE(OPCODE_SET, XTENSA_LX7);
    GDEFINE_ENUM_CASE(OPCODE_SET, CUSTOM);
    }
}
llc::sc_c* llc::get_value_namep     (OPCODE_EXT     value)  nxpt {
    switch(value) {
    GDEFINE_ENUM_CASE_DEFAULT(OPCODE_EXT, NONE);
    GDEFINE_ENUM_CASE(OPCODE_EXT, NONE);
    GDEFINE_ENUM_CASE(OPCODE_EXT, AVX);
    GDEFINE_ENUM_CASE(OPCODE_EXT, MMX);
    GDEFINE_ENUM_CASE(OPCODE_EXT, SSE);
    GDEFINE_ENUM_CASE(OPCODE_EXT, SSE2);
    GDEFINE_ENUM_CASE(OPCODE_EXT, SSE3);
    GDEFINE_ENUM_CASE(OPCODE_EXT, SSE4);
    GDEFINE_ENUM_CASE(OPCODE_EXT, CUSTOM);
    }
}
llc::sc_c* llc::get_value_namep     (OS_FAMILY      value)  nxpt {
    switch(value) {
    GDEFINE_ENUM_CASE_DEFAULT(OS_FAMILY, UNKNOWN);
    GDEFINE_ENUM_CASE(OS_FAMILY, UNKNOWN    );
    GDEFINE_ENUM_CASE(OS_FAMILY, ANDROID    );
    GDEFINE_ENUM_CASE(OS_FAMILY, ARDUINO    );
    GDEFINE_ENUM_CASE(OS_FAMILY, FREERTOS   );
    GDEFINE_ENUM_CASE(OS_FAMILY, IOS        );
    GDEFINE_ENUM_CASE(OS_FAMILY, LINUX      );
    GDEFINE_ENUM_CASE(OS_FAMILY, MACOS      );
    GDEFINE_ENUM_CASE(OS_FAMILY, NO_OS      );
    GDEFINE_ENUM_CASE(OS_FAMILY, PI         );
    GDEFINE_ENUM_CASE(OS_FAMILY, RTOS       );
    GDEFINE_ENUM_CASE(OS_FAMILY, WINDOWS    );
    GDEFINE_ENUM_CASE(OS_FAMILY, CUSTOM     );
    }
}